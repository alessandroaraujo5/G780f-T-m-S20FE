## drivers/soc/samsung/linkforward/Kconfig
```kconfig
#
# SAMSUNG Link Forward Driver
#
menuconfig LINK_FORWARD
	bool "Lower layer packet forwarding/translation support"
	depends on !HW_FORWARD
	default n
	help
	  This option enables link layer forwarding using SW translation.
	  This supports IP packet NAT translation.
	  This option cannot be used with DIT (Direct IP Translation) feature (HW_FORWARD).
```
